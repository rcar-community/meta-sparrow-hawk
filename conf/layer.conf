## conf/layer.conf
```bitbake
# We have a conf and classes directory, add to BBPATH
BBPATH .= ":${LAYERDIR}"

# We have recipes-* directories, add to BBFILES
BBFILES += "${LAYERDIR}/recipes-*/*/*.bb \
    ${LAYERDIR}/recipes-*/*/*.bbappend"

BBFILE_COLLECTIONS += "sparrow-hawk"
BBFILE_PATTERN_sparrow-hawk = "^${LAYERDIR}/"
BBFILE_PRIORITY_sparrow-hawk = "6"
LAYERSERIES_COMPAT_sparrow-hawk = "scarthgap"

LAYERDEPENDS_sparrow-hawk = "core yocto yoctobsp openembedded-layer meta-python networking-layer"
```

## conf/machine/sparrow-hawk.conf
```bitbake
#@TYPE: Machine
#@NAME: Sparrow hawk machine
#@DESCRIPTION: Machine configuration for running sparrow-hawk

SOC_FAMILY = "r8a779g3"
SOC_FAMILY =. "rcar-gen4:"

require conf/machine/include/soc-family.inc

MACHINE_FEATURES = ""
# Add variable to Build Configuration in build log
BUILDCFG_VARS:append = " SOC_FAMILY"

# Configuration for kernel
PREFERRED_PROVIDER_virtual/kernel = "linux-renesas"
KERNEL_IMAGETYPE = "Image"
IMAGE_FSTYPES += " tar.bz2 ext4 wic.gz"
# Device tree
KERNEL_DEVICETREE = "\
    renesas/r8a779g3-sparrow-hawk.dtb \
"
SERIAL_CONSOLES = "921600;ttySC0"

# Configuration for ARM Trusted Firmware
EXTRA_IMAGEDEPENDS += " arm-trusted-firmware"

# u-boot
PREFERRED_VERSION_u-boot = "v2025.10+git%"
EXTRA_IMAGEDEPENDS += " u-boot"
# u-boot configure
UBOOT_MACHINE = "r8a779g3_sparrowhawk_defconfig"

# ipl burning tool
EXTRA_IMAGEDEPENDS += " ipl-burning"

WKS_FILE ?= "rcar-singlepart-noloader.wks"

DEFAULTTUNE ?= "cortexa76"
require conf/machine/include/arm/armv8-2a/tune-cortexa76.inc

MACHINE_EXTRA_RRECOMMENDS = " \
    linux-fitimage kernel-devicetree kernel-modules \
    sparrow-hawk-fw u-boot \
"
```

## meta-sparrow-hawk-bsp/conf/layer.conf
```bitbake
# We have a conf and classes directory, add to BBPATH
BBPATH .= ":${LAYERDIR}"

# We have recipes-* directories, add to BBFILES
BBFILES += "${LAYERDIR}/recipes-*/*/*.bb \
            ${LAYERDIR}/recipes-*/*/*.bbappend"

BBFILE_COLLECTIONS += "sparrow-hawk-bsp"
BBFILE_PATTERN_sparrow-hawk-bsp = "^${LAYERDIR}/"
BBFILE_PRIORITY_sparrow-hawk-bsp = "6"
LAYERSERIES_COMPAT_sparrow-hawk-bsp = "scarthgap"
LAYERDEPENDS_sparrow-hawk-bsp = "core openembedded-layer meta-python"
```

## meta-sparrow-hawk-bsp/conf/machine/sparrow-hawk.conf
```bitbake
#@TYPE: Machine
#@NAME: Sparrow hawk machine
#@DESCRIPTION: Machine configuration for running sparrow-hawk

SOC_FAMILY = "r8a779g3"
SOC_FAMILY =. "rcar-gen4:"

require conf/machine/include/soc-family.inc

MACHINE_FEATURES = ""
# Add variable to Build Configuration in build log
BUILDCFG_VARS:append = " SOC_FAMILY"

# Configuration for kernel
PREFERRED_PROVIDER_virtual/kernel ?= "linux-renesas"
KERNEL_IMAGETYPE = "Image"
IMAGE_FSTYPES += " tar.bz2 ext4 wic.gz wic.bmap"
# Device tree
KERNEL_DEVICETREE = "\
    renesas/r8a779g3-sparrow-hawk.dtb \
"
SERIAL_CONSOLES = "921600;ttySC0"

# Configuration for ARM Trusted Firmware
EXTRA_IMAGEDEPENDS += " arm-trusted-firmware"

# u-boot
EXTRA_IMAGEDEPENDS += " u-boot"
# u-boot configure
UBOOT_MACHINE = "r8a779g3_sparrowhawk_defconfig"

# libcamera
PREFERRED_VERSION_libcamera = "v0.6.0+upstream+git"

# ipl burning tool
EXTRA_IMAGEDEPENDS += " ipl-burning"

WKS_FILE ?= "rcar-singlepart-noloader.wks"

PREFERRED_PROVIDER_virtual/egl = "gles-user-module"
PREFERRED_PROVIDER_virtual/libgles1 = "gles-user-module"
PREFERRED_PROVIDER_virtual/libgles2 = "gles-user-module"
PREFERRED_PROVIDER_virtual/libgles3 = "gles-user-module"
PREFERRED_PROVIDER_virtual/libgbm = "libgbm"
PACKAGECONFIG:remove:pn-mesa = "egl gles gbm"

DEFAULTTUNE ?= "cortexa76"
require conf/machine/include/arm/armv8-2a/tune-cortexa76.inc

MACHINE_EXTRA_RRECOMMENDS = " \
    kernel-devicetree kernel-modules \
    sparrow-hawk-fw u-boot \
"
```

## meta-sparrow-hawk-images/conf/layer.conf
```bitbake
# We have a conf and classes directory, add to BBPATH
BBPATH .= ":${LAYERDIR}"

# We have recipes-* directories, add to BBFILES
BBFILES += "${LAYERDIR}/recipes-*/*/*.bb \
            ${LAYERDIR}/recipes-*/*/*.bbappend"

BBFILE_COLLECTIONS += "sparrow-hawk-images"
BBFILE_PATTERN_sparrow-hawk-images = "^${LAYERDIR}/"
BBFILE_PRIORITY_sparrow-hawk-images = "6"
LAYERSERIES_COMPAT_sparrow-hawk-images = "scarthgap"
LAYERDEPENDS_sparrow-hawk-images = "core openembedded-layer meta-python sparrow-hawk-bsp"
```

## recipes-kernel/linux/linux-fitimage/fit-image.its
```
/dts-v1/;

/ {
	description = "Linux kernel and FDT blob for r8a779g3-sparrow-hawk";

	images {
		kernel-1 {
			description = "Linux kernel";
			data = /incbin/("./Image");
			type = "kernel";
			arch = "arm64";
			os = "linux";
			compression = "none";
			load = <0x50200000>;
			entry = <0x50200000>;
			hash-1 {
				algo = "crc32";
			};
		};
		fdt-1 {
			description = "Flattened Device Tree blob";
			data = /incbin/("./r8a779g3-sparrow-hawk.dtb");
			type = "flat_dt";
			arch = "arm64";
			compression = "none";
			hash-1 {
				algo = "crc32";
			};
		};
		atf-1 {
			description = "ARM Trusted Firmware";
			data = /incbin/("./bl31.bin");
			type = "tfa-bl31";
			arch = "arm64";
			os = "arm-trusted-firmware";
			compression = "none";
			load = <0x46400000>;
			entry = <0x46400000>;
			hash-1 {
				algo = "crc32";
			};
		};
		ramdisk-1 {
			description = "Initramfs for driver loading";
			data = /incbin/("./uInitramfs.cpio.gz");
			type = "ramdisk";
			arch = "arm64";
			os = "linux";
			compression = "none";
			hash-1 {
				algo = "crc32";
			};
		};
		script {
			description = "Boot script for automatic applying dt-overlay ";
			data = /incbin/("./boot.cmd");
			type = "script";
			arch = "arm64";
			os = "u-boot";
			compression = "none";
			hash-1 {
				algo = "crc32";
			};
		};

		fdt-j1-imx219 {
			description = "Flattened Device Tree Overlay";
			data = /incbin/("./r8a779g3-sparrow-hawk-camera-j1-imx219.dtbo");
			type = "flat_dt";
			arch = "arm64";
			compression = "none";
			hash-1 {
				algo = "crc32";
			};
		};
		fdt-j2-imx219 {
			description = "Flattened Device Tree Overlay";
			data = /incbin/("./r8a779g3-sparrow-hawk-camera-j2-imx219.dtbo");
			type = "flat_dt";
			arch = "arm64";
			compression = "none";
			hash-1 {
				algo = "crc32";
			};
		};
		fdt-j1-imx462 {
			description = "Flattened Device Tree Overlay";
			data = /incbin/("./r8a779g3-sparrow-hawk-camera-j1-imx462.dtbo");
			type = "flat_dt";
			arch = "arm64";
			compression = "none";
			hash-1 {
				algo = "crc32";
			};
		};
		fdt-j2-imx462 {
			description = "Flattened Device Tree Overlay";
			data = /incbin/("./r8a779g3-sparrow-hawk-camera-j2-imx462.dtbo");
			type = "flat_dt";
			arch = "arm64";
			compression = "none";
			hash-1 {
				algo = "crc32";
			};
		};
		fdt-j1-imx708 {
			description = "Flattened Device Tree Overlay";
			data = /incbin/("./r8a779g3-sparrow-hawk-camera-j1-imx708.dtbo");
			type = "flat_dt";
			arch = "arm64";
			compression = "none";
			hash-1 {
				algo = "crc32";
			};
		};
		fdt-j2-imx708 {
			description = "Flattened Device Tree Overlay";
			data = /incbin/("./r8a779g3-sparrow-hawk-camera-j2-imx708.dtbo");
			type = "flat_dt";
			arch = "arm64";
			compression = "none";
			hash-1 {
				algo = "crc32";
			};
		};
		fdt-fan-argon40 {
			description = "Flattened Device Tree Overlay";
			data = /incbin/("./r8a779g3-sparrow-hawk-fan-argon40.dtbo");
			type = "flat_dt";
			arch = "arm64";
			compression = "none";
			hash-1 {
				algo = "crc32";
			};
		};
		fdt-fan-pwm {
			description = "Flattened Device Tree Overlay";
			data = /incbin/("./r8a779g3-sparrow-hawk-fan-pwm.dtbo");
			type = "flat_dt";
			arch = "arm64";
			compression = "none";
			hash-1 {
				algo = "crc32";
			};
		};
		fdt-rpi-display-2-5in {
			description = "Flattened Device Tree Overlay";
			data = /incbin/("./r8a779g3-sparrow-hawk-rpi-display-2-5in.dtbo");
			type = "flat_dt";
			arch = "arm64";
			compression = "none";
			hash-1 {
				algo = "crc32";
			};
		};
		fdt-rpi-display-2-7in {
			description = "Flattened Device Tree Overlay";
			data = /incbin/("./r8a779g3-sparrow-hawk-rpi-display-2-7in.dtbo");
			type = "flat_dt";
			arch = "arm64";
			compression = "none";
			hash-1 {
				algo = "crc32";
			};
		};
		fdt-waveshare-panel {
			description = "Flattened Device Tree Overlay";
			data = /incbin/("./r8a779g3-sparrow-hawk-dsi-waveshare-panel.dtbo");
			type = "flat_dt";
			arch = "arm64";
			compression = "none";
			hash-1 {
				algo = "crc32";
			};
		};
		fdt-mipi-hdmi {
			description = "Flattened Device Tree Overlay";
			data = /incbin/("./r8a779g3-sparrow-hawk-dsi-mipi-hmdi.dtbo");
			type = "flat_dt";
			arch = "arm64";
			compression = "none";
			hash-1 {
				algo = "crc32";
			};
		};
	};

	configurations {
		default = "default";
		default {
			description = "Boot Linux kernel with FDT blob";
			kernel = "kernel-1";
			fdt = "fdt-1";
			loadables = "atf-1";
			hash-1 {
				algo = "crc32";
			};
		};
		initramfs {
			description = "Boot Linux kernel with FDT blob/Initramfs";
			kernel = "kernel-1";
			fdt = "fdt-1";
			loadables = "atf-1";
			ramdisk = "ramdisk-1";
			hash-1 {
				algo = "crc32";
			};
		};

		j1-imx219 {
			fdt = "fdt-j1-imx219";
		};
		j2-imx219 {
			fdt = "fdt-j2-imx219";
		};
		j1-imx462 {
			fdt = "fdt-j1-imx462";
		};
		j2-imx462 {
			fdt = "fdt-j2-imx462";
		};
		j1-imx708 {
			fdt = "fdt-j1-imx708";
		};
		j2-imx708 {
			fdt = "fdt-j2-imx708";
		};
		fan-argon40 {
			fdt = "fdt-fan-argon40";
		};
		fan-pwm {
			fdt = "fdt-fan-pwm";
		};
		rpi-display-2 { // For backward compatibility
			fdt = "fdt-rpi-display-2-7in";
		};
		rpi-display-2-7in {
			fdt = "fdt-rpi-display-2-7in";
		};
		rpi-display-2-5in {
			fdt = "fdt-rpi-display-2-5in";
		};
		waveshare-panel {
			fdt = "fdt-waveshare-panel";
		};
		mipi-hdmi {
			fdt = "fdt-mipi-hdmi";
		};
	};
};
```
